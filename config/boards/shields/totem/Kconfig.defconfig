## config/boards/shields/totem/Kconfig.defconfig
```kconfig
# Copyright (c) 2022 The ZMK Contributors
# SPDX-License-Identifier: MIT

if SHIELD_TOTEM_LEFT

config ZMK_KEYBOARD_NAME
    default "TOTEM"
    
config ZMK_SPLIT_ROLE_CENTRAL
    default y

endif

if SHIELD_TOTEM_RIGHT

config ZMK_SPLIT_ROLE_PERIPHERAL
    bool
    default y

endif

if SHIELD_TOTEM_CLEAR_BONDING

config ZMK_SPLIT_ROLE_PERIPHERAL
    bool
    default y

config ZMK_BLE_CLEAR_BONDS_ON_START
    bool
    default y

config ZMK_BLE_CLEAR_BONDS_ON_BOOT
    bool
    default y

endif

if SHIELD_TOTEM_LEFT || SHIELD_TOTEM_RIGHT || SHIELD_TOTEM_CLEAR_BONDING

config ZMK_SPLIT
    default y

endif
```
